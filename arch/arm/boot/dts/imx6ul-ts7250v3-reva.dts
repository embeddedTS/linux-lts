// SPDX-License-Identifier: (GPL-2.0+ OR X11)
/*
 * Copyright 2019-2022 Technologic Systems, Inc. dba embeddedTS
 */

/dts-v1/;
#include <dt-bindings/input/input.h>
#include <dt-bindings/leds/common.h>
#include "imx6ul-ts7250v3.dtsi"

/ {
	model = "embeddedTS i.MX6UL TS-7250-V3 (REV A)";
};

&wdt {
	status = "okay";
};

&m41t00s {
	status = "okay";
};

&pc104bus {
	reset-gpio = <&gpio3 7 GPIO_ACTIVE_HIGH>;
};

