// SPDX-License-Identifier: GPL-2.0 OR X11
/*
 * Copyright 2015 Technologic Systems, Inc. dba embeddedTS
 */

/dts-v1/;
#include "imx6q.dtsi"
#include "imx6qdl-ts4900.dtsi"

/ {
	model = "embeddedTS i.MX6 Quad TS-4900 (Default Device Tree)";
	compatible = "technologic,imx6q-ts4900", "fsl,imx6q";

	/* Will be filled by the bootloader */
	memory@10000000 {
		device_type = "memory";
		reg = <0x10000000 0>;
	};
};

&sata {
	status = "okay";
};

&iomuxc {
	pinctrl-names = "default";
	pinctrl-0 = <&pinctrl_muxbus_gpio &pinctrl_lcd_gpio &pinctrl_i2s_gpio &pinctrl_hog>;
};
