// SPDX-License-Identifier: GPL-2.0 OR X11
/*
 * Copyright (C) 2023 Technologic Systems, Inc. dba embeddedTS
 */

/dts-v1/;
#include "imx6ul-ts4100.dtsi"
#include "imx6ul-ts4100-ts8820.dtsi"

/ {
	model = "embeddedTS i.MX6UL TS-4100 (TS-8820)";
	compatible = "fsl,imx6ul-ts4100", "fsl,imx6ul";
};
