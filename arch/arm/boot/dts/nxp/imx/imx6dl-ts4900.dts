// SPDX-License-Identifier: GPL-2.0 OR X11
/*
 * Copyright 2015-2022 Technologic Systems, Inc. dba embeddedTS
 */

/dts-v1/;
#include "imx6dl.dtsi"
#include "imx6qdl-ts4900.dtsi"

/ {
	model = "embeddedTS i.MX6 Solo/DualLite TS-4900 (Default Device Tree)";
	compatible = "technologic,imx6dl-ts4900", "fsl,imx6dl";

	/* Will be filled by the bootloader */
	memory@10000000 {
		device_type = "memory";
		reg = <0x10000000 0>;
	};
};

&iomuxc {
	pinctrl-names = "default";
	pinctrl-0 = <&pinctrl_muxbus_gpio &pinctrl_lcd_gpio &pinctrl_i2s_gpio &pinctrl_hog>;
};
