// SPDX-License-Identifier: GPL-2.0 OR X11
/*
 * Copyright (C) 2019-2022 Technologic Systems, Inc. dba embeddedTS
 */

/dts-v1/;
#include <dt-bindings/input/input.h>
#include <dt-bindings/leds/common.h>
#include "imx6ul-ts7250v3.dtsi"

&supervisor {
	status = "okay";
};

&supervisor_rtc {
	status = "okay";
};
