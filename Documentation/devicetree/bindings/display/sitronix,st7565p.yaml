## Documentation/devicetree/bindings/display/sitronix,st7565p.yaml
```yaml
# SPDX-License-Identifier: (GPL-2.0-only OR BSD-2-Clause)
%YAML 1.2
---
$id: http://devicetree.org/schemas/display/sitronix,st7565p.yaml#
$schema: http://devicetree.org/meta-schemas/core.yaml#

title: Sitronix ST7565P Display Controller

maintainers:
  - Technologic Systems

description:
  Sitronix ST7565P is a monochrome dot matrix LCD controller.

allOf:
  - $ref: panel/panel-common.yaml#

properties:
  compatible:
    const: sitronix,st7565p
  reg:
    maxItems: 1
  sitronix,inverted:
    type: boolean
  reset-gpios: true
  dc-gpios: true
  width-mm: true
  height-mm: true
  panel-timing: true

required:
  - compatible
  - reg
  - width-mm
  - height-mm
  - panel-timing

additionalProperties: false
```

## Documentation/devicetree/bindings/mfd/technologic,ts-supervisor-gen0.yaml
```yaml
# SPDX-License-Identifier: (GPL-2.0-only OR BSD-2-Clause)
%YAML 1.2
---
$id: http://devicetree.org/schemas/mfd/technologic,ts-supervisor-gen0.yaml#
$schema: http://devicetree.org/meta-schemas/core.yaml#

title: embeddedTS supervisor IP generation 0

maintainers:
  - Mark Featherston <mark@embeddedts.com>

description: |
  Generation 0 supervisor IP is used by the TS-4100, TS-7400-V2,
  TS-7553-V2, TS-7670 and TS-7680. Its watchdog and reset commands use
  the legacy I2C protocol. Optional child functions are described by
  their own compatible strings.

properties:
  compatible:
    const: technologic,ts-supervisor-gen0

  reg:
    maxItems: 1

  adc:
    type: object
    additionalProperties: false
    properties:
      compatible:
        const: technologic,ts7553v2-supervisor-adc
      '#io-channel-cells':
        const: 1
    required:
      - compatible
      - '#io-channel-cells'

  reset:
    type: object
    additionalProperties: false
    properties:
      compatible:
        enum:
          - technologic,ts-supervisor-reset
          - technologic,ts-supervisor-gen0-reset
          - technologic,ts7680-supervisor-reset
      technologic,skip-micro-handler:
        type: boolean
        description: Do not use the supervisor as a system restart handler.
    required:
      - compatible

  watchdog:
    $ref: /schemas/watchdog/technologic,ts-wdt.yaml#

  supercaps:
    type: object
    additionalProperties: false
    properties:
      compatible:
        enum:
          - technologic,ts4100-silo
          - technologic,ts7553v2-silo
      power-fail-gpios:
        maxItems: 1
    required:
      - compatible

required:
  - compatible
  - reg

additionalProperties: false

examples:
  - |
    #include <dt-bindings/gpio/gpio.h>
    i2c {
        #address-cells = <1>;
        #size-cells = <0>;
        supervisor@2a {
            compatible = "technologic,ts-supervisor-gen0";
            reg = <0x2a>;
            reset {
                compatible = "technologic,ts-supervisor-gen0-reset";
            };
            watchdog {
                compatible = "technologic,ts-wdt";
                timeout-sec = <500>;
                enable-early;
            };
            supercaps {
                compatible = "technologic,ts7553v2-silo";
                power-fail-gpios = <&gpio5 0 GPIO_ACTIVE_HIGH>;
            };
        };
    };
```

## Documentation/devicetree/bindings/mfd/technologic,ts-supervisor-gen1.yaml
```yaml
# SPDX-License-Identifier: (GPL-2.0-only OR BSD-2-Clause)
%YAML 1.2
---
$id: http://devicetree.org/schemas/mfd/technologic,ts-supervisor-gen1.yaml#
$schema: http://devicetree.org/meta-schemas/core.yaml#

title: embeddedTS supervisor IP generation 1

maintainers:
  - Mark Featherston <mark@embeddedts.com>

description: |
  Generation 1 supervisor IP is used by the TS-7100 and TS-7180. It provides
  ADC, supercapacitor, reset and watchdog functions over an I2C register map.

properties:
  compatible:
    const: technologic,ts-supervisor-gen1

  reg:
    maxItems: 1

  adc:
    type: object
    additionalProperties: false
    properties:
      compatible:
        enum:
          - technologic,ts7100-supervisor-adc
          - technologic,ts7180-supervisor-adc
      '#io-channel-cells':
        const: 1
    required:
      - compatible
      - '#io-channel-cells'

  reset:
    type: object
    additionalProperties: false
    properties:
      compatible:
        const: technologic,ts-supervisor-reset
      technologic,skip-micro-handler:
        type: boolean
        description: Do not use the supervisor as a system restart handler.
    required:
      - compatible

  watchdog:
    $ref: /schemas/watchdog/technologic,ts-wdt.yaml#

  supercaps:
    type: object
    additionalProperties: false
    properties:
      compatible:
        const: technologic,ts7100-silo
    required:
      - compatible

required:
  - compatible
  - reg
  - adc
  - supercaps

additionalProperties: false

examples:
  - |
    i2c {
        #address-cells = <1>;
        #size-cells = <0>;
        supervisor@54 {
            compatible = "technologic,ts-supervisor-gen1";
            reg = <0x54>;
            adc {
                compatible = "technologic,ts7100-supervisor-adc";
                #io-channel-cells = <1>;
            };
            supercaps {
                compatible = "technologic,ts7100-silo";
            };
            watchdog {
                compatible = "technologic,ts-wdt";
            };
        };
    };
```

## Documentation/devicetree/bindings/mfd/technologic,ts4100-supervisor.yaml
```yaml
# SPDX-License-Identifier: (GPL-2.0-only OR BSD-2-Clause)
%YAML 1.2
---
$id: http://devicetree.org/schemas/mfd/technologic,ts4100-supervisor.yaml#
$schema: http://devicetree.org/meta-schemas/core.yaml#

title: embeddedTS TS-4100 supervisory microcontroller

maintainers:
  - Mark Featherston <mark@embeddedts.com>

description: |
  This controller sends a fixed ADC snapshot on each I2C read. Single-byte
  writes control the supercapacitor charger and push-switch reset enable.
  Power-fail is a separate GPIO.

properties:
  compatible:
    const: technologic,ts4100-supervisor
  reg:
    maxItems: 1
  reset:
    type: object
    additionalProperties: false
    properties:
      compatible:
        const: technologic,ts4100-supervisor-reset
      ts,skip-micro-handler:
        type: boolean
        description: Do not use the supervisor as a system restart handler.
    required:
      - compatible

  watchdog:
    $ref: /schemas/watchdog/technologic,ts-wdt.yaml#

  supercaps:
    type: object
    additionalProperties: false
    properties:
      compatible:
        const: technologic,ts4100-silo
      power-fail-gpios:
        maxItems: 1
    required:
      - compatible
      - power-fail-gpios

required:
  - compatible
  - reg
  - supercaps
additionalProperties: false

examples:
  - |
    #include <dt-bindings/gpio/gpio.h>
    i2c {
        #address-cells = <1>;
        #size-cells = <0>;
        microcontroller@4a {
            compatible = "technologic,ts4100-supervisor";
            reg = <0x4a>;
            supercaps {
                compatible = "technologic,ts4100-silo";
                power-fail-gpios = <&gpio5 0 GPIO_ACTIVE_HIGH>;
            };
        };
    };
```

## Documentation/devicetree/bindings/mfd/technologic,ts7100-supervisor.yaml
```yaml
# SPDX-License-Identifier: (GPL-2.0-only OR BSD-2-Clause)
%YAML 1.2
---
$id: http://devicetree.org/schemas/mfd/technologic,ts7100-supervisor.yaml#
$schema: http://devicetree.org/meta-schemas/core.yaml#

title: embeddedTS TS-7100 supervisory microcontroller

maintainers:
  - Mark Featherston <mark@embeddedts.com>

description: |
  The microcontroller provides ADC readings and supercapacitor charging
  controls. The TS-7180 firmware exposes channels 0 through 3 as raw ADC
  readings; the TS-7100 firmware returns these channels in millivolts.

properties:
  compatible:
    const: technologic,ts7100-supervisor

  reg:
    maxItems: 1

  adc:
    type: object
    additionalProperties: false
    properties:
      compatible:
        enum:
          - technologic,ts7100-supervisor-adc
          - technologic,ts7180-supervisor-adc
      '#io-channel-cells':
        const: 1
    required:
      - compatible
      - '#io-channel-cells'

  watchdog:
    $ref: /schemas/watchdog/technologic,ts-wdt.yaml#

  supercaps:
    type: object
    additionalProperties: false
    properties:
      compatible:
        const: technologic,ts7100-silo
    required:
      - compatible

required:
  - compatible
  - reg
  - adc
  - supercaps

additionalProperties: false

examples:
  - |
    i2c {
        #address-cells = <1>;
        #size-cells = <0>;
        microcontroller@54 {
            compatible = "technologic,ts7100-supervisor";
            reg = <0x54>;
            adc {
                compatible = "technologic,ts7100-supervisor-adc";
                #io-channel-cells = <1>;
            };
            supercaps {
                compatible = "technologic,ts7100-silo";
            };
        };
    };
```

## Documentation/devicetree/bindings/mfd/technologic,ts7553v2-supervisor.yaml
```yaml
# SPDX-License-Identifier: (GPL-2.0-only OR BSD-2-Clause)
%YAML 1.2
---
$id: http://devicetree.org/schemas/mfd/technologic,ts7553v2-supervisor.yaml#
$schema: http://devicetree.org/meta-schemas/core.yaml#

title: embeddedTS TS-7553-V2 supervisory microcontroller

maintainers:
  - Mark Featherston <mark@embeddedts.com>

description: |
  This controller sends a fixed ADC snapshot on each I2C read. Single-byte
  writes control the supercapacitor charger. Power-fail is a separate GPIO.

properties:
  compatible:
    const: technologic,ts7553v2-supervisor
  reg:
    maxItems: 1
  adc:
    type: object
    additionalProperties: false
    properties:
      compatible:
        const: technologic,ts7553v2-supervisor-adc
      '#io-channel-cells':
        const: 1
    required:
      - compatible
      - '#io-channel-cells'
  watchdog:
    $ref: /schemas/watchdog/technologic,ts-wdt.yaml#

  supercaps:
    type: object
    additionalProperties: false
    properties:
      compatible:
        const: technologic,ts7553v2-silo
      power-fail-gpios:
        maxItems: 1
    required:
      - compatible
      - power-fail-gpios

required:
  - compatible
  - reg
  - adc
  - supercaps
additionalProperties: false

examples:
  - |
    #include <dt-bindings/gpio/gpio.h>
    i2c {
        #address-cells = <1>;
        #size-cells = <0>;
        microcontroller@2a {
            compatible = "technologic,ts7553v2-supervisor";
            reg = <0x2a>;
            adc {
                compatible = "technologic,ts7553v2-supervisor-adc";
                #io-channel-cells = <1>;
            };
            supercaps {
                compatible = "technologic,ts7553v2-silo";
                power-fail-gpios = <&gpio5 0 GPIO_ACTIVE_HIGH>;
            };
        };
    };
```

## Documentation/devicetree/bindings/watchdog/technologic,ts-wdt.yaml
```yaml
# SPDX-License-Identifier: (GPL-2.0-only OR BSD-2-Clause)
%YAML 1.2
---
$id: http://devicetree.org/schemas/watchdog/technologic,ts-wdt.yaml#
$schema: http://devicetree.org/meta-schemas/core.yaml#

title: embeddedTS supervisory microcontroller watchdog

maintainers:
  - Mark Featherston <mark@embeddedts.com>

description: |
  The watchdog is a child of an embeddedTS supervisory microcontroller and
  communicates over the parent's I2C connection.

properties:
  compatible:
    const: technologic,ts-wdt

  enable-early:
    type: boolean
    description: Assume the watchdog was started by the bootloader.

  timeout-sec:
    $ref: /schemas/types.yaml#/definitions/uint32

  status: true

  technologic,skip-micro-handler:
    type: boolean
    description: Do not use the watchdog as a system restart handler.

required:
  - compatible

additionalProperties: false

examples:
  - |
    i2c {
        #address-cells = <1>;
        #size-cells = <0>;
        supervisor@54 {
            compatible = "technologic,ts-supervisor-gen1";
            reg = <0x54>;
            watchdog {
                compatible = "technologic,ts-wdt";
            };
        };
    };
...
```

## drivers/pinctrl/technologic/Kconfig
```kconfig
# SPDX-License-Identifier: GPL-2.0-only
config PINCTRL_TSXBAR
	tristate
	depends on OF
	depends on ARCH_MXC
	select GENERIC_PINCTRL_GROUPS
	select GENERIC_PINMUX_FUNCTIONS
	select PINCONF
	select REGMAP

config PINCTRL_TS9370
	tristate "TS-9370 pinctrl driver"
	depends on ARCH_MXC
	select PINCTRL_TSXBAR
	help
	  Say Y here to enable the TS-9370 pinctrl driver
```
