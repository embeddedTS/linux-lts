## Documentation/devicetree/bindings/mmc/technologic,tssdcard.yaml
```yaml
# SPDX-License-Identifier: (GPL-2.0-only OR BSD-2-Clause)
%YAML 1.2
---
$id: http://devicetree.org/schemas/mmc/technologic,tssdcard.yaml#
$schema: http://devicetree.org/meta-schemas/core.yaml#

title: Technologic Systems TS-7800-V2 SD card controller

maintainers:
  - Mark Featherston <mark@embeddedts.com>

description: |
  The TS-7800-V2 FPGA contains an SD card controller connected to the
  system's microSD slot. The host drives command and control phases through
  the controller's GPIO register. The FPGA can burst four-bit read and write
  data with a fixed 25 MHz clock. Lower operating frequencies use the GPIO
  interface for data as well. The microSD slot has no card-detect or
  write-protect signal.

allOf:
  - $ref: mmc-controller.yaml#

properties:
  compatible:
    const: technologic,tssdcard

  reg:
    maxItems: 1

  max-frequency:
    maximum: 25000000

required:
  - compatible
  - reg

unevaluatedProperties: false

examples:
  - |
    soc@0 {
        compatible = "simple-bus";
        reg = <0 0x100000>;
        #address-cells = <2>;
        #size-cells = <1>;
        ranges = <2 0 0 0x100000>;

        mmc@200000100 {
            compatible = "technologic,tssdcard";
            reg = <2 0x100 0x200>;
            bus-width = <4>;
            max-frequency = <25000000>;
            broken-cd;
            disable-wp;
        };
    };
```
